## boards/shields/corn/Kconfig.defconfig
```kconfig
if SHIELD_CORN_LEFT

config ZMK_KEYBOARD_NAME
    default "corn"

config ZMK_SPLIT_ROLE_CENTRAL
    default y

config ZMK_SLEEP
    default y 

endif


if SHIELD_CORN_RIGHT

config ZMK_SPLIT_ROLE_CENTRAL
    default n

config ZMK_SLEEP
    default n

endif 


if SHIELD_CORN_LEFT || SHIELD_CORN_RIGHT

config ZMK_SPLIT
    default y

config ZMK_BLE
    default y 

config ZMK_BLE_EXPERIMENTAL_CONN
    default y

config SYSTEM_WORKQUEUE_STACK_SIZE
    default 2048

config ZMK_SPLIT_BLE_CENTRAL_BATTERY_LEVEL_PROXY 
    default y 

config ZMK_SPLIT_BLE_CENTRAL_BATTERY_LEVEL_FETCHING 
    default y 

endif
```

## boards/shields/corn/Kconfig.shield
```kconfig
config SHIELD_CORN_LEFT
    def_bool $(shields_list_contains,corn_left)

config SHIELD_CORN_RIGHT
    def_bool $(shields_list_contains,corn_right)
```
