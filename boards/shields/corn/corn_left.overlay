/*
 * 
 * this has not yet been edited from the sofle default 
 * 
 */

#include "corn.dtsi"

&kscan0 {
    col-gpios
        = <&xiao_d 1 GPIO_ACTIVE_HIGH>
        , <&xiao_d 2 GPIO_ACTIVE_HIGH>
        , <&xiao_d 3 15 GPIO_ACTIVE_HIGH>
        , <&xiao_d 4 GPIO_ACTIVE_HIGH>
        , <&xiao_d 5 16 GPIO_ACTIVE_HIGH>
        , <&xiao_d 6 10 GPIO_ACTIVE_HIGH>
        ;
};