/*
 * 
 * this has not yet been edited from the sofle deafult 
 * 
 */

#include "corn.dtsi"

&default_transform {
    col-offset = <6>;
};

&kscan0 {
    col-gpios
        = <&xiao_d 6 GPIO_ACTIVE_HIGH>
        , <&xiao_d 5 GPIO_ACTIVE_HIGH>
        , <&xiao_d 4 15 GPIO_ACTIVE_HIGH>
        , <&xiao_d 3 GPIO_ACTIVE_HIGH>
        , <&xiao_d 2 16 GPIO_ACTIVE_HIGH>
        , <&xiao_d 1 10 GPIO_ACTIVE_HIGH>
        ;
};

&right_encoder {
    status = "okay";
};